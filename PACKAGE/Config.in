## PACKAGE/Config.in
```kconfig
config BR2_PACKAGE_LIBPIGPIO
	bool "libpigpio"
	help
	  libpigpio is a C library for the Raspberry Pi which allows control of the general purpose input outputs (gpios).
```
